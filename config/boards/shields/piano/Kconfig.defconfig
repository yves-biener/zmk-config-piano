## config/boards/shields/piano/Kconfig.defconfig
```kconfig
if SHIELD_PIANO_DONGLE || SHIELD_PIANO_NORM_LEFT || SHIELD_PIANO_NORM_RIGHT

config ZMK_KEYBOARD_NAME
	default "The Piano"

endif
if SHIELD_PUNI

config ZMK_KEYBOARD_NAME
	default "Puni"

endif


if SHIELD_PIANO_DONGLE_LEFT || SHIELD_PIANO_DONGLE_RIGHT || SHIELD_PIANO_NORM_RIGHT

config ZMK_SPLIT
	default y

endif



if SHIELD_PIANO_DONGLE || SHIELD_PIANO_NORM_LEFT

config ZMK_SPLIT
	default y

config ZMK_SPLIT_ROLE_CENTRAL
	default y

endif
```
